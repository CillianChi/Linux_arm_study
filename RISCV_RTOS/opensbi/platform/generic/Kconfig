## RISCV_RTOS/opensbi/platform/generic/Kconfig
```kconfig
# SPDX-License-Identifier: BSD-2-Clause

config PLATFORM_GENERIC
	bool
	select FDT
	select FDT_DOMAIN
	select FDT_PMU
	default y

if PLATFORM_GENERIC

config PLATFORM_GENERIC_NAME
	string "Platform default name"
	default "Generic"

config PLATFORM_GENERIC_MAJOR_VER
	int "Platform major version"
	range 0 65535
	default 0

config PLATFORM_GENERIC_MINOR_VER
	int "Platform minor version"
	range 0 65535
	default 1

config PLATFORM_ALLWINNER_D1
	bool "Allwinner D1 support"
	depends on FDT_IRQCHIP_PLIC
	select THEAD_C9XX_PMU
	default n

config PLATFORM_ANDES_AE350
	bool "Andes AE350 support"
	select SYS_ATCSMU
	select ANDES_PMU
	select ANDES_PMA
	default n

config PLATFORM_RENESAS_RZFIVE
	bool "Renesas RZ/Five support"
	select ANDES_PMA
	select ANDES_SBI
	select ANDES_PMU
	default n

config PLATFORM_SIFIVE_FU540
	bool "SiFive FU540 support"
	default n

config PLATFORM_SIFIVE_FU740
	bool "SiFive FU740 support"
	depends on FDT_RESET && FDT_I2C
	default n

config PLATFORM_SOPHGO_SG2042
	bool "Sophgo sg2042 support"
	select THEAD_C9XX_ERRATA
	select THEAD_C9XX_PMU
	default n

config PLATFORM_STARFIVE_JH7110
	bool "StarFive JH7110 support"
	default n

config PLATFORM_THEAD
	bool "THEAD C9xx support"
	select THEAD_C9XX_ERRATA
	select THEAD_C9XX_PMU
	default n

config PLATFORM_MIPS_P8700
	bool "MIPS P8700 support"
	default n

config PLATFORM_GENERIC_MY_QEMU_VIRT
    bool "My QEMU Virt Platform"
    # 使用 CLINT timer，必要
    select PLATFORM_HAS_TIMER_VALUE
    # 表示我們會支援 m-mode fault delegation
    select PLATFORM_HAS_MFAULTS_DELEGATION
    # 告知 OpenSBI 會初始化 PLIC 中斷控制器
    select PLATFORM_NEEDS_PLIC
    # 告知 OpenSBI 初始化 UART（串列輸出用）
    select PLATFORM_HAS_UART
    # 預設啟用（如果平台名稱為 generic/my-qemu-virt）
    default y if PLATFORM=generic/my-qemu-virt

source "$(OPENSBI_SRC_DIR)/platform/generic/andes/Kconfig"
source "$(OPENSBI_SRC_DIR)/platform/generic/thead/Kconfig"

endif
```

## RISCV_RTOS/opensbi/platform/generic/my-qemu-virt/Kconfig
```kconfig
config PLATFORM_GENERIC_MY_QEMU_VIRT
    bool "My QEMU Virt Platform"
    # 使用 CLINT timer，必要
    select PLATFORM_HAS_TIMER_VALUE
    # 表示我們會支援 m-mode fault delegation
    select PLATFORM_HAS_MFAULTS_DELEGATION
    # 告知 OpenSBI 會初始化 PLIC 中斷控制器
    select PLATFORM_NEEDS_PLIC
    # 告知 OpenSBI 初始化 UART（串列輸出用）
    select PLATFORM_HAS_UART
    # 預設啟用（如果平台名稱為 generic/my-qemu-virt）
    default y if PLATFORM=generic/my-qemu-virt
```
